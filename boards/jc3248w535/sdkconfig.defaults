## components/audio/Kconfig
```kconfig
menu "hassctrl audio"

    config HC_AUDIO
        bool "Audio output"
        depends on HC_BOARD_HAS_AUDIO
        default y
        help
            Sound through the board's I2S amplifier and speaker (hc::board::Info::audio_*): the
            audio task, the Sound page of Settings and the `sound` console command. Only boards
            with an amplifier offer it; without it none of the audio code is in the firmware.

    config HC_AUDIO_TOUCH_SOUND
        bool "Touch sounds"
        depends on HC_AUDIO
        default y
        help
            A short click for every tap on a button, a tile or a row, switched on and off in
            Settings, Sound. Without it the click and its switch are not in the firmware.

    config HC_AUDIO_MP3
        bool "MP3 files"
        depends on HC_AUDIO
        default y
        help
            Plays MP3 files from the file system (/fs/sounds), such as the alarm sounds, with
            Espressif's esp_audio_codec. Without it only the built-in sounds play.

    config HC_UI_PLAYER
        bool "Media player"
        depends on HC_AUDIO_MP3
        default y
        # the covers of the tags are PNG or JPEG (main/ui_player.cpp: LVGL's lodepng)
        select LV_USE_PNG
        help
            A player that runs in the background: MP3 files of Home Assistant's media library,
            streamed while they play, and with an SD card (HC_SDCARD) its MP3 and WAV files and
            playlists. A queue with next, previous, shuffle and repeat; the title, artist and
            cover from the files' tags; pause, seek and a spectrum analyser. Without it the file
            manager only lists, renames and deletes.

    config HC_AUDIO_ALARM
        bool "Alarm clock"
        depends on HC_AUDIO
        default y
        help
            An alarm in Settings that rings at a time and on chosen days, at full volume, with
            snooze. The sounds are the built-in beeps and, with HC_AUDIO_MP3, the MP3 files.

    config HC_MIC
        bool "Microphone"
        depends on HC_AUDIO && HC_BOARD_HAS_MIC
        default y
        help
            The microphone of the board's audio codec on the same I2S port as the speaker: its
            gain or automatic level control and a level meter in Settings, Sound, console `mic`.
            Without it the codec's input stays off and none of the microphone code is in the
            firmware.

endmenu
```

## components/board/Kconfig
```kconfig
menu "hassctrl board"

    choice HC_BOARD
        prompt "Board"
        help
            The board the firmware is built for. Each board's sdkconfig.defaults in boards/<name>/
            selects it, see docs/architecture.md section 8.

        config HC_BOARD_WT32_SC01
            bool "Wireless-Tag WT32-SC01 (ESP32, 480x320 ST7796S, FT6336U touch)"
            depends on IDF_TARGET_ESP32
            select HC_BOARD_HAS_VIBRATION

        config HC_BOARD_TTGO_T4
            bool "LilyGO TTGO T4 v1.3 (ESP32, 320x240 ILI9341, no touch, test device only)"
            depends on IDF_TARGET_ESP32

        config HC_BOARD_JC3248W535
            bool "Guition JC3248W535 (ESP32-S3, 320x480 AXS15231B over QSPI, integrated touch)"
            depends on IDF_TARGET_ESP32S3
            select HC_BOARD_HAS_AUDIO

        config HC_BOARD_JC4880P443C
            bool "Guition JC4880P443C (ESP32-P4 + C6, 480x800 ST7701S over MIPI-DSI, GT911 touch)"
            depends on IDF_TARGET_ESP32P4
            select HC_BOARD_HAS_AUDIO
            select HC_BOARD_HAS_VIBRATION
            select HC_BOARD_HAS_CAMERA
            select HC_BOARD_HAS_MIC
            select HC_BOARD_HAS_SDCARD
    endchoice

    config HC_BOARD_HAS_AUDIO
        bool
        help
            The board has an I2S amplifier for a speaker (hc::board::Info::audio_*); it makes
            the audio component's options available (CONFIG_HC_AUDIO).

    config HC_BOARD_HAS_MIC
        bool
        help
            The board has a microphone behind its audio codec (hc::board::Info::audio_din_gpio);
            it makes the microphone option available (CONFIG_HC_MIC).

    config HC_BOARD_HAS_VIBRATION
        bool
        help
            The board has a vibration motor (hc::board::Info::vibration_gpio); it makes the
            vibration component's option available (CONFIG_HC_VIBRATION).

    config HC_BOARD_HAS_CAMERA
        bool
        help
            The board has a MIPI-CSI camera connector: the camera component, Settings, Camera with
            its preview, and the stream at /api/camera.jpg and /api/camera.mjpg.

    config HC_BOARD_HAS_SDCARD
        bool
        help
            The board has a microSD slot on the SDMMC host (hc::board::Info::sd_*); it makes the
            SD card option available (CONFIG_HC_SDCARD).

    config HC_BOARD_BRING_UP
        bool "Board bring-up: start with the test screen"
        default n
        help
            Only while a board is added (docs/adding-a-board.md): the main firmware starts with the
            display test screen (color bars, refresh times, touch, backlight calibration) over the
            start screen, until a dashboard is drawn. Set it in boards/<name>/sdkconfig.defaults
            and remove it again once the board's constants are in its board::Info; without it the
            test screen is not in the firmware.

endmenu
```

## components/devconsole/Kconfig
```kconfig
menu "hassctrl development console"

    config HC_DEV_CONSOLE
        bool "Serial console for development"
        default y
        help
            A command line on the serial port: Wi-Fi networks, hotspot, file system, restart and
            factory reset. For testing before the setup screens exist; removable with this option.

endmenu
```

## components/sdcard/Kconfig
```kconfig
menu "hassctrl SD card"

    config HC_SDCARD
        bool "SD card"
        depends on HC_BOARD_HAS_SDCARD
        default y
        help
            The board's microSD slot (hc::board::Info::sd_*): FAT at /sd, mounted at boot, alarm
            sounds from /sd/sounds/alarms, mic recordings saved as WAV, the SD card page of the
            web UI (files, upload, download from a URL, rename/move, format), the file manager
            in Settings, System and the console command `sd`.
            Only boards with a slot offer it; without it none of the SD code is in the firmware.

endmenu
```

## components/vibration/Kconfig
```kconfig
menu "hassctrl vibration"

    config HC_VIBRATION
        bool "Vibration motor"
        depends on HC_BOARD_HAS_VIBRATION
        default y
        help
            A vibration motor on a GPIO (hc::board::Info::vibration_gpio): a pulse with every tap
            that clicks, a pattern while the alarm rings, the Vibration switch in Settings, Sound
            and the `vibrate` console command. Only boards with a motor offer it.

endmenu
```

## components/webserver/Kconfig
```kconfig
menu "hassctrl web server"

    config HC_WEB_FIRMWARE_ROUTES
        bool "API of the firmware's pages"
        default y
        help
            The routes only the main firmware serves: Home Assistant, dashboard, backup, camera,
            player and time (/api/hass, /api/dashboard, /api/backup, /api/camera, /api/player,
            /api/time). Off in the recovery app (sdkconfig.recovery), which has none of these;
            its web pages answer the 404 with "not in the recovery app". The time routes alone
            bring the time zone table and SNTP into the image.

endmenu
```
